## CMakeLists.txt
```
# =============================================================================
# CMakeLists.txt – Hello World for Zephyr (pure CMake, no west)
# Target board: STM32 Nucleo L010RB  (nucleo_l010rb)
# =============================================================================
cmake_minimum_required(VERSION 3.20.0)

# --------------------------------------------------------------------------
# ZEPHYR_BASE must point to the Zephyr source tree.
# Inside the Docker container it is /zephyrproject/zephyr (set by run_docker.sh).
# On the host, set it via environment variable or pass -DZEPHYR_BASE=...
# --------------------------------------------------------------------------
if(NOT DEFINED ENV{ZEPHYR_BASE} AND NOT DEFINED ZEPHYR_BASE)
    message(FATAL_ERROR
        "ZEPHYR_BASE is not set. "
        "Export ZEPHYR_BASE to point to the Zephyr source tree, e.g.:\n"
        "  export ZEPHYR_BASE=/zephyrproject/zephyr"
    )
endif()

# Set the target board if not already provided via -DBOARD=...
if(NOT DEFINED BOARD AND DEFINED ENV{BOARD})
    set(BOARD $ENV{BOARD})
endif()
if(NOT DEFINED BOARD)
    set(BOARD nucleo_l010rb)
endif()

# Pull in the Zephyr build system (this replaces the west build step)
# ZEPHYR_MODULES is passed via environment or -D flag by build.sh
find_package(Zephyr REQUIRED HINTS $ENV{ZEPHYR_BASE})

project(hello_world LANGUAGES C)

target_sources(app PRIVATE src/main.c)
```

## prj.conf
```kconfig
# Zephyr Hello-World application configuration
# Target: STM32 Nucleo L010RB

CONFIG_GPIO=y
CONFIG_SERIAL=y
CONFIG_CONSOLE=y
CONFIG_UART_CONSOLE=y
CONFIG_PRINTK=y
```

## src/main.c
```c
/*
 * Hello World sample for Zephyr RTOS
 * Target board: STM32 Nucleo L010RB (nucleo_l010rb)
 *
 * Prints "Hello World" to the UART console and then blinks the on-board LED.
 */

#include <zephyr/kernel.h>
#include <zephyr/drivers/gpio.h>
#include <zephyr/sys/printk.h>

/* LED0 is the green user LED (LD2) on the Nucleo L010RB */
#define LED0_NODE DT_ALIAS(led0)
static const struct gpio_dt_spec led = GPIO_DT_SPEC_GET(LED0_NODE, gpios);

#define SLEEP_TIME_MS 1000

int main(void)
{
    int ret;

    printk("Hello World! Running on %s\n", CONFIG_BOARD);

    if (!gpio_is_ready_dt(&led)) {
        printk("LED device not ready\n");
        return 0;
    }

    ret = gpio_pin_configure_dt(&led, GPIO_OUTPUT_ACTIVE);
    if (ret < 0) {
        printk("Failed to configure LED pin (err %d)\n", ret);
        return 0;
    }

    printk("Blinking LED ...\n");

    while (1) {
        gpio_pin_toggle_dt(&led);
        k_msleep(SLEEP_TIME_MS);
    }

    return 0;
}
```
